## FKLab_KB/Kconfig.defconfig
```kconfig
# Copyright (c) 2020 The ZMK Contributors
# SPDX-License-Identifier: MIT

if BOARD_FKLab_KB

config ZMK_KEYBOARD_NAME
	default "FKLab_KB"

config USB_NRFX
	default y

config USB_DEVICE_STACK
	default y

config BT_CTLR
	default BT

config ZMK_BLE
	default y

config ZMK_USB
	default y

endif # BOARD_FKLab_KB
```

## FKLab_KB_defconfig
```kconfig
# SPDX-License-Identifier: MIT

CONFIG_SOC_SERIES_NRF52X=y
CONFIG_SOC_NRF52840_QIAA=y
CONFIG_BOARD_FKLab_KB=y

# Enable MPU
CONFIG_ARM_MPU=y

# enable GPIO
CONFIG_GPIO=y

CONFIG_USE_DT_CODE_PARTITION=y
CONFIG_BUILD_OUTPUT_UF2=y

CONFIG_MPU_ALLOW_FLASH_WRITE=y
CONFIG_NVS=y
CONFIG_SETTINGS_NVS=y
CONFIG_FLASH=y
CONFIG_FLASH_PAGE_LAYOUT=y
CONFIG_FLASH_MAP=y

# vendor ID and product ID
CONFIG_USB_DEVICE_VID=0x1D50
CONFIG_USB_DEVICE_PID=0x615E

# Enable the rotary encoder
CONFIG_EC11=y
CONFIG_EC11_TRIGGER_GLOBAL_THREAD=y

# The manufacturer name advertised to USB	
CONFIG_USB_DEVICE_MANUFACTURER="FKLab"

# Turn on logging, and set ZMK logging to debug output
CONFIG_ZMK_USB_LOGGING=y

# enale underglow
CONFIG_ZMK_RGB_UNDERGLOW=y
# Use the STRIP config specific to the LEDs you're using
CONFIG_WS2812_STRIP=y

# more POWER
CONFIG_BT_CTLR_TX_PWR_PLUS_8=y
```

## Kconfig.board
```kconfig
# FKLab_KB board configuration

# Copyright (c) 2020 The ZMK Contributors
# SPDX-License-Identifier: MIT

config BOARD_FKLab_KB
	bool "FKLab_KB Keyboard"
	depends on SOC_NRF52840_QIAA
```
